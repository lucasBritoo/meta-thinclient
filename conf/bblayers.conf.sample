## conf/bblayers.conf.sample
```bitbake
# Esta variavel indica a versao do arquivo de configuracao. Ela é usada para
# verificar se o arquivo foi alterado de forma incompativel com versoes anterioes.
# Se houver alteracao eh incrementada. O build eh realizado em build/conf/bblayers.conf
POKY_BBLAYERS_CONF_VERSION = "2"

# Indica o caminho base para o bitbake encontrar os arquivos. TOPDIR referencia o diretório raiz do Yocto
BBPATH = "${TOPDIR}"

# Define uma lista de arquivos de receita a serem considerados. No caso abaixo está vazio.
BBFILES ?= ""

# Define as camadas que o Yocto deve usar durante a construção da imagem.
BBLAYERS ?= " \
  ${TOPDIR}/../layers/meta \
  ${TOPDIR}/../layers/meta-poky \
  ${TOPDIR}/../layers/meta-yocto-bsp \
  ${TOPDIR}/../layers/meta-oe/meta-oe \
  ${TOPDIR}/../layers/meta-oe/meta-filesystems \
  ${TOPDIR}/../layers/meta-oe/meta-multimedia \
  ${TOPDIR}/../layers/meta-oe/meta-networking \
  ${TOPDIR}/../layers/meta-oe/meta-python \
  ${TOPDIR}/../layers/meta-qt5 \
  ${TOPDIR}/../layers/meta-raspberrypi \
  ${TOPDIR}/../layers/meta-rust-bin \
  ${TOPDIR}/../layers/meta-updatehub \
  ${TOPDIR}/../layers/meta-updatehub-qa \
  ${TOPDIR}/../layers/meta-updatehub-raspberrypi \
  ${TOPDIR}/../layers/meta-thinclient \
  "
```

## conf/layer.conf
```bitbake
# Indica o caminho base para o bitbake encontrar os arquivos
# LAYERDIR referencia o diretório atual
BBPATH .= ":${LAYERDIR}"

# Define uma lista de arquivos de receita a serem considerados
BBFILES += "${LAYERDIR}/recipes-*/*.bb \
            ${LAYERDIR}/recipes-*/*.bbappend \
            ${LAYERDIR}/recipes-*/*/*.bb \
            ${LAYERDIR}/recipes-*/*/*.bbappend"

# Define o nome da colletion para esta collection
BBFILE_COLLECTIONS += "meta-thinclient"

# Define quais arquivos .bb devem ser considerados
# São considerados todos os .bb desta layer
BBFILE_PATTERN_meta-thinclient = "^${LAYERDIR}/"

# Define prioridade desta layer no momento do build como 11. Quanto menor mais prioritário.
# Verificar o bblayers.conf
BBFILE_PRIORITY_meta-thinclient = "16"

# Define uma dependência com a layer core. A layer core deve ser carregada primeiro
LAYERDEPENDS_meta-thinclient = "core"

# Define a compatibilidade desta layer somente com a série Dunfell do Yocto
LAYERSERIES_COMPAT_meta-thinclient = "dunfell"
```

## conf/local.conf.sample
```bitbake
# Define a máquina alvo
MACHINE = "raspberrypi3"

# Define o diretório onde os arquivos de origem (downloads) devem ser armazenados 
DL_DIR ?= "${TOPDIR}/../dl"

# Define o diretório onde o Yocto armazena as informações de estado intermediário para acelerar compilações futuras.
SSTATE_DIR ?= "${TOPDIR}/sstate-cache"

# Define o diretório temporário usado pelo Yocto para compilar pacotes e construir imagens
TMPDIR = "${TOPDIR}/tmp"

# Define a distribuição usada pelo Yocto
DISTRO = "poky"

# Define o tipo de pacote a ser gerado apos compilacao. 
PACKAGE_CLASSES = "package_ipk"

# Define as classes de usuários usadas no ambiente de construção
# buildstats = coleta estatisticas de build 
# image-mklibs = usada para otimizar as bibliotecas compartilhadas em imagens
# image-prelink = aplica prelink as bibliotecas das imagens. Isso acelera o tempo de inicialização de aplicativos
USER_CLASSES ?= "buildstats image-mklibs image-prelink"

# Define a resolução de patches.
# Noop significa que os patches não serão resolvidos automaticamente
PATCHRESOLVE = "noop"

# Define os diretórios que serão montados quanto ao uso de disco durante a compilação
# e especifica ações a serem tomadas quando os limites de uso de disco são atingidos.
# AÇÃO, DIRETÓRIO, LIMITE DE ESPAÇO, TAMANHO MÍNIMO DE ARQUIVO
# AÇÃO = STOPTASKS | ABORT
BB_DISKMON_DIRS ??= "\
    STOPTASKS,${TMPDIR},1G,100K \
    STOPTASKS,${DL_DIR},1G,100K \
    STOPTASKS,${SSTATE_DIR},1G,100K \
    STOPTASKS,/tmp,100M,100K \
    ABORT,${TMPDIR},100M,1K \
    ABORT,${DL_DIR},100M,1K \
    ABORT,${SSTATE_DIR},100M,1K \
    ABORT,/tmp,10M,1K"

# Versão da configuração local
CONF_VERSION = "1"

# -------------------------------------------------------#
# Definicao do Raspberry
# -------------------------------------------------------#

# Tipo de filessystem
# rpi-sdimg = formato específico para imagem em cartão SD para raspberry
IMAGE_FSTYPES_append = " rpi-sdimg"

# Define a utilização do u-boot
RPI_USE_U_BOOT = "1"

# Desativa os gráficos VC4 - Drivers para GPU
DISABLE_VC4GRAPHICS = "1"

# Desativa o Overscan
# Overscan é uma técnica para ajustar exibição de vídeo em telas de TV antigas referente a bordas da imagem.
DISABLE_OVERSCAN = "0"
# ENABLE_UART = "1"
# SERIAL_CONSOLES = "115200;ttyAMA0"


# -------------------------------------------------------#
# Definicao da distro
# -------------------------------------------------------#

# Desabilita as gettys do SysVinit
# Getty gerencia o acesso a terminais de texto (TTY). Desligar ele é útil para configurar um sistema para não usar terminais de texto
SYSVINIT_ENABLED_GETTYS = ""

# Define recursos considerados para a distribuicao como sysvinit
# Sysvinit é um sistema de inicialização
DISTRO_FEATURES_BACKFILL_CONSIDERED = "sysvinit"

# Adiciona recursos a distro
DISTRO_FEATURES_append = " bluetooth wifi systemd gstreamer pam opengl"

# Remove recursos da distro 
DISTRO_FEATURES_remove = " x11 vulkan wayland irda pcmcia nfc nfs"

# Define o systemD como init manager
VIRTUAL-RUNTIME_init_manager = "systemd"

# Define que não serão usadas scripts de inicalização
VIRTUAL-RUNTIME_initscripts = ""

# Provedor de pacotes udev
PREFERRED_PROVIDER_udev = "systemd"
PREFERRED_PROVIDER_udev-utils = "systemd"

# Provedor de pacotes jpeg
PREFERRED_PROVIDER_jpeg = "libjpeg-turbo"
PREFERRED_PROVIDER_jpeg-native = "libjpeg-turbo-native"

# Remove as imagens antigas durante o processo de construção
RM_OLD_IMAGE = "1"

# Habilita a herança da classe rm_work que remove diretórios de trabalho após a construção
INHERIT += " rm_work"


# -------------------------------------------------------#
# Definicao do UpdateHub
# -------------------------------------------------------#

UPDATEHUB_SERVER_URL = "http://192.168.0.9:8080/"
UPDATEHUB_PACKAGE_VERSION_SUFFIX = "-test-image-1"
```
